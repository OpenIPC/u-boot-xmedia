## board/xmedia/xm72020300/Kconfig
```kconfig
if TARGET_XM72020300

config SYS_BOARD
	default "xm72020300"

config SYS_VENDOR
	default "xmedia"

config SYS_SOC
	default "xm72020300"

config SYS_CONFIG_NAME
	default "xm72020300"

endif
```

## board/xmedia/xm72050200/Kconfig
```kconfig
if TARGET_XM72050200

config SYS_BOARD
	default "xm72050200"

config SYS_VENDOR
	default "xmedia"

config SYS_SOC
	default "xm72050200"

config SYS_CONFIG_NAME
	default "xm72050200"

endif
```

## board/xmedia/xm72050300/Kconfig
```kconfig
if TARGET_XM72050300

config SYS_BOARD
	default "xm72050300"

config SYS_VENDOR
	default "xmedia"

config SYS_SOC
	default "xm72050300"

config SYS_CONFIG_NAME
	default "xm72050300"

endif
```

## board/xmedia/xm72050500/Kconfig
```kconfig
if TARGET_XM72050500

config SYS_BOARD
	default "xm72050500"

config SYS_VENDOR
	default "xmedia"

config SYS_SOC
	default "xm72050500"

config SYS_CONFIG_NAME
	default "xm72050500"

endif
```

## board/xmedia/xm720xxx/Kconfig
```kconfig
if TARGET_XM720XXX

config SYS_BOARD
	default "xm720xxx"

config SYS_VENDOR
	default "xmedia"

config SYS_SOC
	default "xm720xxx"

config SYS_CONFIG_NAME
	default "xm720xxx"

endif
```

## board/xmedia/xm76050100/Kconfig
```kconfig
if TARGET_XM76050100

config SYS_BOARD
	default "xm76050100"

config SYS_VENDOR
	default "xmedia"

config SYS_SOC
	default "xm76050100"

config SYS_CONFIG_NAME
	default "xm76050100"

endif
```

## drivers/ddr/Kconfig
```kconfig
source "drivers/ddr/altera/Kconfig"
source "drivers/ddr/imx/Kconfig"
source "drivers/ddr/xmedia/Kconfig"
```

## drivers/ddr/xmedia/Kconfig
```kconfig
config DDR_TRAINING_V2
	bool "ddr training test tool"
	default n
	help
	  DDR training test tool.
```

## drivers/lhs/i2c/Kconfig
```kconfig
#
# I2C subsystem configuration
#

menu "LHS I2C support"

config LHS_I2C
        bool "lhs i2c"
        help
          LHS I2C support.

config CMD_LHS_I2C
        bool "cmd lhs i2c"
        help
          CMD LHS I2C support.

endmenu
```

## drivers/phy/xmedia/Kconfig
```kconfig
config PHY_VENDOR_USB
	bool "xmedia usb phy driver"
	default y
	---help---
	  support for PHY on xmedia Socs. This Phy supports
	  USB 1.5Mb/s, USB 12Mb/s, USB 480Mb/s speeds. It suppots one
	  USB host port to accept one USB device. Support init the phy
	  and adjust phy Eye Diagram.
```
